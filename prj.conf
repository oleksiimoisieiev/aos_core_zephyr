## CMakeLists.txt
```
#
# Copyright (C) 2023 Renesas Electronics Corporation.
# Copyright (C) 2023 EPAM Systems, Inc.
#
# SPDX-License-Identifier: Apache-2.0
#

cmake_minimum_required(VERSION 3.13.1)

find_package(Zephyr REQUIRED HINTS $ENV{ZEPHYR_BASE})

include($ENV{ZEPHYR_BASE}/cmake/app/boilerplate.cmake NO_POLICY_SCOPE)

set(UTILS_SCRIPTS_DIR ${CMAKE_CURRENT_SOURCE_DIR}/scripts)
if (DTC)
  add_custom_target(
    fix_dtb
    DEPENDS ${ZEPHYR_FINAL_EXECUTABLE}
    COMMAND ${UTILS_SCRIPTS_DIR}/fix_dtb.sh ${UTILS_SCRIPTS_DIR}/gicv2.tmpl ${ZEPHYR_BINARY_DIR}/virt_gicv2.dtb ${ZEPHYR_BINARY_DIR}/zephyr.bin)
else()
  message(WARNING "No dtc program")
endif()

project(aoszephyrapp)

# ######################################################################################################################
# Includes
# ######################################################################################################################

zephyr_include_directories(${CMAKE_CURRENT_BINARY_DIR} src)
# Add prebuilt to includes so assembler can find this files
include_directories(app PRIVATE ${CMAKE_CURRENT_SOURCE_DIR}/prebuilt)

# ######################################################################################################################
# Taget
# ######################################################################################################################

target_sources(
    app PRIVATE src/main.cpp src/logger/logger.cpp src/app/app.cpp src/cmclient/cmclient.cpp src/runner/runner.cpp
                src/storage/storage.cpp src/domd_cfg.c src/domain_bins.S
)

# ######################################################################################################################
# Versioning
# ######################################################################################################################

find_package(Git)

if(NOT GIT_FOUND)
    set(GIT_EXECUTABLE git)
endif()

set(CMAKE_MODULE_PATH ${PROJECT_SOURCE_DIR}/CMakeModules)

add_custom_target(
    version
    COMMAND
        ${CMAKE_COMMAND} -D GIT_EXECUTABLE=${GIT_EXECUTABLE} -D INPUT_FILE=${CMAKE_SOURCE_DIR}/src/version.hpp.in -D
        OUTPUT_FILE=${CMAKE_CURRENT_BINARY_DIR}/version.hpp -D GIT_SOURCE_DIR=${CMAKE_SOURCE_DIR} -P
        ${CMAKE_MODULE_PATH}/GenerateVersion.cmake
)

add_dependencies(app version)

# ######################################################################################################################
# External libs
# ######################################################################################################################

include(ExternalProject)

zephyr_get_include_directories_for_lang_as_string(CXX includes)
zephyr_get_system_include_directories_for_lang_as_string(CXX system_includes)
zephyr_get_compile_definitions_for_lang_as_string(CXX definitions)
zephyr_get_compile_options_for_lang_as_string(CXX options)

set(external_project_cxx_flags "${includes} ${system_includes} ${definitions} ${options}")

# ######################################################################################################################
# aos_core_lib_cpp
# ######################################################################################################################

set(aos_cxx_flags "${external_project_cxx_flags} -Wno-pedantic -Wno-error")

# Aos core configuration

if(NOT BOARD MATCHES "native_posix*")
    zephyr_compile_definitions(-DAOS_CONFIG_DEFAULT_THREAD_STACK_SIZE=1024)
endif()

set(AOSCORE_BUILD_DIR ${CMAKE_CURRENT_BINARY_DIR}/aoscore)

ExternalProject_Add(
    aoscore
    PREFIX ${AOSCORE_BUILD_DIR}
    CMAKE_ARGS -DCMAKE_INSTALL_PREFIX=${AOSCORE_BUILD_DIR} -DCMAKE_C_COMPILER=${CMAKE_C_COMPILER}
               -DCMAKE_CXX_COMPILER=${CMAKE_CXX_COMPILER} -DCMAKE_SYSTEM_NAME=${CMAKE_SYSTEM_NAME}
               -DCMAKE_SYSTEM_PROCESSOR=${CMAKE_SYSTEM_PROCESSOR} -DCMAKE_CXX_FLAGS=${aos_cxx_flags}
    SOURCE_DIR ${APPLICATION_SOURCE_DIR}/../aos_core_lib_cpp
    BUILD_BYPRODUCTS ${AOSCORE_BUILD_DIR}/lib/libaossmcpp.a ${AOSCORE_BUILD_DIR}/lib/libaosiamcpp.a
)

# aossm

file(MAKE_DIRECTORY ${AOSCORE_BUILD_DIR}/include)

add_library(aossm STATIC IMPORTED GLOBAL)

add_dependencies(aossm aoscore)

set_target_properties(aossm PROPERTIES IMPORTED_LOCATION ${AOSCORE_BUILD_DIR}/lib/libaossmcpp.a)
set_target_properties(aossm PROPERTIES INTERFACE_INCLUDE_DIRECTORIES ${AOSCORE_BUILD_DIR}/include)

target_link_libraries(app PUBLIC aossm)
```

## west.yml
```
#
# Copyright (C) 2023 Renesas Electronics Corporation.
# Copyright (C) 2023 EPAM Systems, Inc.
#
# SPDX-License-Identifier: Apache-2.0
#

# West YAML manifest for Zephyr as Xen Dom0

manifest:
  self:
    path: aos_core_zephyr

  remotes:
    - name: xen-troops
      url-base: https://github.com/xen-troops

    - name: aoscloud
      url-base: https://github.com/aoscloud

    - name: zephyrproject-rtos
      url-base: https://github.com/zephyrproject-rtos

    - name: amoi
      url-base: https://github.com/oleksiimoisieiev/

    - name: dsemenets
      url-base: https://github.com/dsemenets/

  projects:
    - name: zephyr
      remote: dsemenets
      revision: spider_board
      west-commands: scripts/west-commands.yml

    - name: aos_core_lib_cpp
      remote: aoscloud
      revision: develop

    - name: zephyr-xenlib
      remote: amoi
      revision: xrun_upstr

    - name: littlefs
      remote: zephyrproject-rtos
      path: modules/fs/littlefs
      groups:
        - fs
      revision: ca583fd297ceb48bced3c2548600dc615d67af24
```

## prj.conf
```kconfig
#
# Copyright (c) 2023 EPAM Systems
#
# SPDX-License-Identifier: Apache-2.0
#

# ######################################################################################################################
# System params
# ######################################################################################################################

# Set mem parameters

CONFIG_HEAP_MEM_POOL_SIZE=2097152

# Enable userspace

CONFIG_USERSPACE=y

# Set stack size

CONFIG_MAIN_STACK_SIZE=32768

# Select libc

CONFIG_PICOLIBC=y

# ######################################################################################################################
# Enable C++
# ######################################################################################################################

CONFIG_CPP=y
CONFIG_CPP_MAIN=y
CONFIG_STD_CPP14=y

# ######################################################################################################################
# Logging, errors etc.
# ######################################################################################################################

# Enable logging

CONFIG_LOG=y
CONFIG_LOG_FUNC_NAME_PREFIX_ERR=n
CONFIG_LOG_FUNC_NAME_PREFIX_WRN=n
CONFIG_LOG_FUNC_NAME_PREFIX_INF=n
CONFIG_LOG_FUNC_NAME_PREFIX_DBG=n
CONFIG_LOG_DEFAULT_LEVEL=4
CONFIG_LOG_MODE_DEFERRED=y
CONFIG_LOG_BUFFER_SIZE=4096

# Disable FS log to avoid errors duplication. We catch them by Aos errors.
CONFIG_FS_LOG_LEVEL_OFF=y

# Enable assert for debugging purposes
# TODO: remove for release
CONFIG_ASSERT=y

# ######################################################################################################################
# POSIX configuration
# ######################################################################################################################

CONFIG_PTHREAD_IPC=y
CONFIG_POSIX_API=y
CONFIG_POSIX_FS=y
CONFIG_MAX_PTHREAD_COUNT=16
CONFIG_MAX_PTHREAD_MUTEX_COUNT=32
CONFIG_MAX_PTHREAD_COND_COUNT=32
CONFIG_MAX_THREAD_BYTES=3

# ######################################################################################################################
# 3rd parties modules
# ######################################################################################################################

# Enable mbedtls

CONFIG_MBEDTLS=y
CONFIG_MBEDTLS_BUILTIN=y
CONFIG_MBEDTLS_ZEPHYR_ENTROPY=y
CONFIG_CUSTOM_MBEDTLS_CFG_FILE=y
CONFIG_MBEDTLS_CFG_FILE="aosmbedtlsconfig.h"

# Enable JSON library

CONFIG_JSON_LIBRARY=y

# Enable nanopb library

CONFIG_NANOPB=y

# ######################################################################################################################
# System components
# ######################################################################################################################

# Enable shell support

CONFIG_SHELL=y
CONFIG_SHELL_BACKEND_SERIAL=y

# Enable file system

CONFIG_FILE_SYSTEM=y
CONFIG_FILE_SYSTEM_SHELL=y
CONFIG_FILE_SYSTEM_LITTLEFS=y

# Configure 

CONFIG_FS_LITTLEFS_CACHE_SIZE=512
CONFIG_FS_LITTLEFS_LOOKAHEAD_SIZE=2048

# Enable FLASH

CONFIG_FLASH=y
CONFIG_FLASH_SHELL=y
CONFIG_FLASH_SIMULATOR=y
CONFIG_FLASH_MAP=y

# Enable cpu power management

CONFIG_PM_CPU_OPS=y

# WA: Disable MMC_DMA to avoid z_mem_phys_add assertion
CONFIG_RCAR_MMC_DMA_SUPPORT=n

# Requires by mbedTLS for entropy. Need to be replaced with HW solution.
CONFIG_TEST_RANDOM_GENERATOR=y

# ######################################################################################################################
# Xen and its components
# ######################################################################################################################

# Enable xen

CONFIG_XEN_DOMAIN_MANAGEMENT=y
CONFIG_XEN_CONSOLE_SRV=y
CONFIG_XEN_INITIAL_DOMAIN=y
CONFIG_XEN_STORE_SRV=y
CONFIG_XEN_LIBFDT=y
CONFIG_XEN_SHELL=y

# Enable xrun

CONFIG_XRUN=y
CONFIG_XRUN_SHELL_CMDS=y

# Enable xstat

CONFIG_XSTAT=y
CONFIG_XSTAT_SHELL_CMDS=y

# Enable vchan

CONFIG_XEN_VCH=y
CONFIG_VCH_PATH_MAXLEN=48

# Enable OP-TEE driver and client libraries

CONFIG_TEE=y
CONFIG_OPTEE=y

CONFIG_OPTEE_CLIENT=y
CONFIG_OPTEE_LIBTEEC=y
CONFIG_OPTEE_LIBCKTEEC=y
CONFIG_OPTEE_TEE_SUPPLICANT=y
```

## boards/rcar_h3ulcb_ca57.conf
```kconfig
#
# Copyright (c) 2023 EPAM Systems
#
# SPDX-License-Identifier: Apache-2.0
#
CONFIG_MAIN_STACK_SIZE=4096
CONFIG_MINIMAL_LIBC_MALLOC_ARENA_SIZE=8192
CONFIG_FS_LITTLEFS_FC_HEAP_SIZE=8192

CONFIG_DISK_ACCESS=y
CONFIG_DISK_DRIVERS=y
CONFIG_DISK_DRIVER_SDMMC=y

CONFIG_MMC_RCAR=y
CONFIG_MMC_RCA=1

CONFIG_FS_LITTLEFS_BLK_DEV=y

CONFIG_FILE_SYSTEM=y
CONFIG_FILE_SYSTEM_SHELL=y
CONFIG_FILE_SYSTEM_LITTLEFS=y
```

## boards/rcar_spider.conf
```kconfig
#
# Copyright (c) 2023 EPAM Systems
#
# SPDX-License-Identifier: Apache-2.0
#
CONFIG_MAIN_STACK_SIZE=1048576
CONFIG_MINIMAL_LIBC_MALLOC_ARENA_SIZE=262144
CONFIG_FS_LITTLEFS_FC_HEAP_SIZE=131072

CONFIG_DISK_ACCESS=y
CONFIG_DISK_DRIVERS=y
CONFIG_DISK_DRIVER_SDMMC=y

CONFIG_MMC_RCAR=y
CONFIG_MMC_RCA=1

CONFIG_FS_LITTLEFS_BLK_DEV=y

CONFIG_FILE_SYSTEM=y
CONFIG_FILE_SYSTEM_SHELL=y
CONFIG_FILE_SYSTEM_LITTLEFS=y
```

## boards/xenvm-qemu.conf
```kconfig
CONFIG_FLASH=y
CONFIG_FLASH_SHELL=y
CONFIG_FLASH_SIMULATOR=y
CONFIG_FLASH_MAP=y

CONFIG_FILE_SYSTEM=y
CONFIG_FILE_SYSTEM_SHELL=y
CONFIG_FILE_SYSTEM_LITTLEFS=y
```

## boards/xenvm.conf
```kconfig
CONFIG_FLASH=y
CONFIG_FLASH_SHELL=y
CONFIG_FLASH_SIMULATOR=y
CONFIG_FLASH_MAP=y

CONFIG_FILE_SYSTEM=y
CONFIG_FILE_SYSTEM_SHELL=y
CONFIG_FILE_SYSTEM_LITTLEFS=y
CONFIG_XEN_SHELL_CMDS=n
```

## src/main.cpp
```c
/*
 * Copyright (C) 2023 Renesas Electronics Corporation.
 * Copyright (C) 2023 EPAM Systems, Inc.
 *
 * SPDX-License-Identifier: Apache-2.0
 */
#include <zephyr/sys/__assert.h>
#include <zephyr/sys/printk.h>

#include <aos/common/version.hpp>

#include "app/app.hpp"
#include "logger/logger.hpp"
#include "version.hpp"
#define DEBUG
#if defined(DEBUG)
extern "C" {
#include <zephyr/storage/flash_map.h>

#include <xen_dom_mgmt.h>
#include <xrun.h>
#include <domain.h>

struct xen_domain_cfg domd_cfg;

#define LFS_NAME_MAX 255
#define PARTITION_NODE \
	DT_NODELABEL(storage)

int lsdir(const char *path)
{
	int res;
	struct fs_dir_t dirp;
	static struct fs_dirent entry;

	if (!path) {
		printk("FAIL: Invalid input parameter");
		return -EINVAL;
	}

	fs_dir_t_init(&dirp);

	/* Verify fs_opendir() */
	res = fs_opendir(&dirp, path);
	if (res) {
		printk("FAIL: Error opening dir %s [%d]", path, res);
		return res;
	}

	printk("Listing dir %s ...", path);
	for (;;) {
		/* Verify fs_readdir() */
		res = fs_readdir(&dirp, &entry);

		/* entry.name[0] == 0 means end-of-dir */
		if (res || entry.name[0] == 0) {
			if (res < 0) {
				printk("FAIL: Error reading dir [%d]", res);
			}
			break;
		}

		if (entry.type == FS_DIR_ENTRY_DIR) {
			printk("[DIR ] %s", entry.name);
		} else {
			printk("[FILE] %s (size = %zu)",
					entry.name, entry.size);
		}
	}

	/* Verify fs_closedir() */
	fs_closedir(&dirp);

	return res;
}

int write_file(const char *path, const char *name,
	       char *buf, size_t size)
{
	struct fs_file_t file;
	int rc, ret;
	char fname[LFS_NAME_MAX];

	if (!path || !name || !buf) {
		printk("FAIL: Invalid input parameters");
		return -EINVAL;
	}

        rc = snprintf(fname, LFS_NAME_MAX, "%s/%s", path, name);
	if (rc <= 0) {
		printk("FAIL: Unable to form file path: %d", rc);
		return rc;
	}

	fs_file_t_init(&file);
	rc = fs_open(&file, fname, FS_O_CREATE | FS_O_WRITE);
	if (rc < 0) {
		printk("FAIL: open %s: %d", fname, rc);
		return rc;
	}

	rc = fs_write(&file, buf, size);
	if (rc < 0) {
		printk("FAIL: write %s: %d", fname, rc);
		goto out;
	}

	printk("%s write file size %lu: [wr:%d]", fname, size, rc);

 out:
	ret = fs_close(&file);
	if (ret < 0) {
		printk("FAIL: close %s: %d", fname, ret);
		return ret;
	}

	return (rc < 0 ? rc : 0);
}

static int littlefs_flash_erase(unsigned int id)
{
	const struct flash_area *pfa;
	int rc;

	rc = flash_area_open(id, &pfa);
	if (rc < 0) {
		printk("FAIL: unable to find flash area %u: %d\n",
			id, rc);
		return rc;
	}

	printk("Area %u at 0x%x on %s for %u bytes\n",
		   id, (unsigned int)pfa->fa_off, pfa->fa_dev->name,
		   (unsigned int)pfa->fa_size);

	flash_area_close(pfa);
	return rc;
}

#if DT_NODE_EXISTS(PARTITION_NODE)
FS_FSTAB_DECLARE_ENTRY(PARTITION_NODE);
#else /* PARTITION_NODE */
FS_LITTLEFS_DECLARE_DEFAULT_CONFIG(storage);
static struct fs_mount_t lfs_storage_mnt = {
	.type = FS_LITTLEFS,
	.fs_data = &storage,
	.storage_dev = (void *)FIXED_PARTITION_ID(storage_partition),
	.mnt_point = "/lfs",
};
#endif /* PARTITION_NODE */

	struct fs_mount_t *mp =
#if DT_NODE_EXISTS(PARTITION_NODE)
		&FS_FSTAB_ENTRY(PARTITION_NODE)
#else
		&lfs_storage_mnt
#endif
		;

static int littlefs_mount(struct fs_mount_t *mp)
{
	int rc;

	rc = littlefs_flash_erase((uintptr_t)mp->storage_dev);
	if (rc < 0) {
		return rc;
	}

	/* Do not mount if auto-mount has been enabled */
#if !DT_NODE_EXISTS(PARTITION_NODE) || \
	!(FSTAB_ENTRY_DT_MOUNT_FLAGS(PARTITION_NODE) & FS_MOUNT_FLAG_AUTOMOUNT)
	rc = fs_mount(mp);
	if (rc < 0) {
		printk("Mount id %" PRIuPTR " at %s: %d\n",
			(uintptr_t)mp->storage_dev, mp->mnt_point, rc);
		return rc;
	}
	printk("%s mount: %d\n", mp->mnt_point, rc);
#else
	printk("%s automounted\n", mp->mnt_point);
#endif

	return 0;
}

static int littlefs_umount(struct fs_mount_t *mp)
{
	int rc;

	/* Do not mount if auto-mount has been enabled */
#if !DT_NODE_EXISTS(PARTITION_NODE) ||									\
    !(FSTAB_ENTRY_DT_MOUNT_FLAGS(PARTITION_NODE) & FS_MOUNT_FLAG_AUTOMOUNT)
	rc = fs_umount(mp);
	if (rc < 0) {
		printk("Fail to umount id %" PRIuPTR " at %s: %d\n", (uintptr_t)mp->storage_dev,
				mp->mnt_point, rc);
		return rc;
	}
	printk("%s unmounted: %d\n", mp->mnt_point, rc);
#else
	printk("%s automounted, ignore\n", mp->mnt_point);
#endif

	return 0;
}

char json_msg[] = "{"
	 "\"ociVersion\" : \"1.0.1\", "
		"\"vm\" : { "
			"\"hypervisor\": { "
			"\"path\": \"xen\", "
			"\"parameters\": [\"pvcalls=true\"] "
		"}, "
		"\"kernel\": { "
			"\"path\" : \"/lfs/unikernel.bin\", "
			"\"parameters\" : [ \"port=8124\", \"hello world\" ]"
		"}, "
		"\"hwconfig\": { "
			"\"devicetree\": \"/lfs/uni.dtb\" "
		"} "
	"} "
"}";

extern char __img_unikraft_start[];
extern char __img_unikraft_end[];
extern char __dtb_unikraft_start[];
extern char __dtb_unikraft_end[];

extern void init_root();

static void prepare_configs()
{
	int ret;

	init_root();

	ret = littlefs_mount(mp);
	if (ret) {
		printk("Unable to mount: %d\n", ret);
		return;
	}

	printk("dtb = %p\n", (void *)__dtb_unikraft_start);
	ret = write_file("/lfs", "config.json", json_msg, sizeof(json_msg));
	printk("Write config.json file ret = %d\n", ret);
	ret = write_file("/lfs", "unikernel.bin", __img_unikraft_start,
			__img_unikraft_end - __img_unikraft_start);
	printk("Write unikraft.bim file ret = %d\n", ret);
	ret = write_file("/lfs", "uni.dtb", __dtb_unikraft_start,
			__dtb_unikraft_end - __dtb_unikraft_start);
	printk("Write unikraft.dtb file ret = %d\n", ret);
	ret = lsdir("/lfs");
	printk("lsdir result = %d\n", ret);

	ret = littlefs_umount(mp);
	if (ret)
		printk("Error, unable to unmount %d\n", ret);
}

} /* extern "C" */
#endif /* CONFIG_DEBUG */

int main(void)
{
    printk("*** Aos zephyr application: %s ***\n", AOS_ZEPHYR_APP_VERSION);
    printk("*** Aos core library: %s ***\n", AOS_CORE_VERSION);

	prepare_configs();

    Logger::Init();

    auto& app = App::Get();

    auto err = app.Init();
    __ASSERT(err.IsNone(), "Error initializing application: %s", err.ToString());

    return 0;
}
```

## src/domd_cfg.c
```c
/*
 * Copyright (c) 2023 EPAM Systems
 *
 * SPDX-License-Identifier: Apache-2.0
 */

#include <domain.h>
#include <string.h>
#include <zephyr/xen/public/domctl.h>

static char *domd_dtdevs[] = {
    "/soc/ethernet@e6800000",
    "/soc/dma-controller@e6700000",
    "/soc/dma-controller@e7300000",
    "/soc/dma-controller@e7310000",
    "/soc/dma-controller@ec700000",
    "/soc/dma-controller@ec720000",
    "/soc/dma-controller@e65a0000",
    "/soc/dma-controller@e65b0000",
    "/soc/usb@ee000000",
    "/soc/usb@ee080000",
    "/soc/usb@ee080100",
    "/soc/usb@ee0a0000",
    "/soc/usb@ee0a0100",
    "/soc/mmc@ee100000",
    "/soc/mmc@ee140000",
    "/soc/mmc@ee160000",
    "/soc/fdpm@fe940000",
    "/soc/vspm@fe960000",
    "/soc/vspm@fe9a0000",
    "/soc/fcp@fea27000",
    "/soc/fcp@fea2f000",
    "/soc/fcp@fea37000",
    "/soc/hdmi@fead0000",
    "/soc/vcp4@fe90f000",
    "/soc/gsx_pv0_domd",
    "/soc/gsx_pv1_domd",
    "/soc/pcie@fe000000",
    "/soc/pcie@ee800000",
    "/soc/dma-controller@ffc10000",
    "/soc/video@e6ef0000",
    "/soc/video@e6ef1000",
    "/soc/video@e6ef2000",
    "/soc/video@e6ef3000",
    "/soc/video@e6ef4000",
    "/soc/video@e6ef5000",
    "/soc/video@e6ef6000",
    "/soc/video@e6ef7000",
};

static char *dt_passthrough_nodes[] = {
    "/gsx_opp_table0",
    "/gsx_opp_table1",
    "/gsx_opp_table2",
    "/gsx_opp_table3",
    "/gsx_opp_table4",
    "/gsx_opp_table5",
    "/gsx_opp_table6",
    "/gsx_opp_table7",
    "/extal",
    "/extalr",
    "/audio_clk_a",
    "/audio_clk_b",
    "/audio_clk_c",
    "/can",
    "/scif",
    "/pcie_bus",
    "/msiof-ref-clock",
    "/soc",
    "/audio-clkout",
    "/avb-mch@ec5a0100",
    "/backlight",
    "/cvbs-in",
    "/hdmi-in",
    "/regulator0",
    "/regulator1",
    "/regulator2",
    "/sound",
    "/regulator-vbus0-usb2",
    "/regulator-vcc-sdhi0",
    "/regulator-vccq-sdhi0",
    "/regulator-vcc-sdhi3",
    "/regulator-vccq-sdhi3",
    "/hdmi0-out",
    "/hdmi1-out",
    "/vga",
    "/vga-encoder",
    "/lvds",
    "/x12",
    "/x21-clock",
    "/x22-clock",
    "/x23-clock",
    "/vspm_if",
    "/usb3s0",
    "/usb_extal",
    "/reserved-memory",
    "/mmngr",
    "/mmngrbuf",
};

static struct xen_domain_iomem domd_iomems[] = {
	{ .first_mfn = 0x54000, .nr_mfns = 0x3000},
	{ .first_mfn = 0xe6020, .nr_mfns = 0x1},
	{ .first_mfn = 0xe6050, .nr_mfns = 0x1},
	{ .first_mfn = 0xe6051, .nr_mfns = 0x1},
	{ .first_mfn = 0xe6052, .nr_mfns = 0x1},
	{ .first_mfn = 0xe6053, .nr_mfns = 0x1},
	{ .first_mfn = 0xe6054, .nr_mfns = 0x1},
	{ .first_mfn = 0xe6055, .nr_mfns = 0x1},
	{ .first_mfn = 0xe6260, .nr_mfns = 0x1},
	{ .first_mfn = 0xe6060, .nr_mfns = 0x1},
	{ .first_mfn = 0xe6150, .nr_mfns = 0x1},
	{ .first_mfn = 0xe6160, .nr_mfns = 0x1},
	{ .first_mfn = 0xfff00, .nr_mfns = 0x1},
	{ .first_mfn = 0xe6180, .nr_mfns = 0x1},
	{ .first_mfn = 0xe61c0, .nr_mfns = 0x1},
	{ .first_mfn = 0xe6e31, .nr_mfns = 0x1},
	{ .first_mfn = 0xe6e32, .nr_mfns = 0x1},
	{ .first_mfn = 0xe6510, .nr_mfns = 0x1},
	{ .first_mfn = 0xe66d8, .nr_mfns = 0x1},
	{ .first_mfn = 0xe65ee, .nr_mfns = 0x1},
	{ .first_mfn = 0xe6601, .nr_mfns = 0x1},
	{ .first_mfn = 0xe6800, .nr_mfns = 0x1},
	{ .first_mfn = 0xe6a00, .nr_mfns = 0x10},
	{ .first_mfn = 0xe6e68, .nr_mfns = 0x1},
	{ .first_mfn = 0xfea80, .nr_mfns = 0x10},
	{ .first_mfn = 0xfeaa0, .nr_mfns = 0x10},
	{ .first_mfn = 0xee200, .nr_mfns = 0x1},
	{ .first_mfn = 0x08000, .nr_mfns = 0x2000},
	{ .first_mfn = 0x0a000, .nr_mfns = 0x2000},
	{ .first_mfn = 0xee208, .nr_mfns = 0x1},
	{ .first_mfn = 0xe6ef0, .nr_mfns = 0x1},
	{ .first_mfn = 0xe6ef1, .nr_mfns = 0x1},
	{ .first_mfn = 0xe6ef2, .nr_mfns = 0x1},
	{ .first_mfn = 0xe6ef3, .nr_mfns = 0x1},
	{ .first_mfn = 0xe6ef4, .nr_mfns = 0x1},
	{ .first_mfn = 0xe6ef5, .nr_mfns = 0x1},
	{ .first_mfn = 0xe6ef6, .nr_mfns = 0x1},
	{ .first_mfn = 0xe6ef7, .nr_mfns = 0x1},
	{ .first_mfn = 0xe6700, .nr_mfns = 0x10},
	{ .first_mfn = 0xe7300, .nr_mfns = 0x10},
	{ .first_mfn = 0xe7310, .nr_mfns = 0x10},
	{ .first_mfn = 0xec700, .nr_mfns = 0x10},
	{ .first_mfn = 0xec720, .nr_mfns = 0x10},
	{ .first_mfn = 0xe65a0, .nr_mfns = 0x1},
	{ .first_mfn = 0xe65b0, .nr_mfns = 0x1},
	{ .first_mfn = 0xe6590, .nr_mfns = 0x1},
	{ .first_mfn = 0xee000, .nr_mfns = 0x1},
	{ .first_mfn = 0xee020, .nr_mfns = 0x1},
	{ .first_mfn = 0xee080, .nr_mfns = 0x1},
	{ .first_mfn = 0xee0a0, .nr_mfns = 0x1},
	{ .first_mfn = 0xee100, .nr_mfns = 0x2},
	{ .first_mfn = 0xee140, .nr_mfns = 0x2},
	{ .first_mfn = 0xee160, .nr_mfns = 0x2},
	{ .first_mfn = 0xec500, .nr_mfns = 0x1},
	{ .first_mfn = 0xec5a0, .nr_mfns = 0x1},
	{ .first_mfn = 0xec540, .nr_mfns = 0x1},
	{ .first_mfn = 0xec541, .nr_mfns = 0x1},
	{ .first_mfn = 0xec760, .nr_mfns = 0x1},
	{ .first_mfn = 0xec000, .nr_mfns = 0x1},
	{ .first_mfn = 0xec008, .nr_mfns = 0x1},
	{ .first_mfn = 0xfe000, .nr_mfns = 0x80},
	{ .first_mfn = 0xee800, .nr_mfns = 0x80},
	{ .first_mfn = 0xe67e0, .nr_mfns = 0x11},
	{ .first_mfn = 0xfd000, .nr_mfns = 0x40},
	{ .first_mfn = 0xfe900, .nr_mfns = 0x1},
	{ .first_mfn = 0xfe910, .nr_mfns = 0x1},
	{ .first_mfn = 0xfe8d0, .nr_mfns = 0x1},
	{ .first_mfn = 0xfe90f, .nr_mfns = 0x1},
	{ .first_mfn = 0xfe940, .nr_mfns = 0x3},
	{ .first_mfn = 0xfe950, .nr_mfns = 0x1},
	{ .first_mfn = 0xfe960, .nr_mfns = 0x8},
	{ .first_mfn = 0xfe96f, .nr_mfns = 0x1},
	{ .first_mfn = 0xfe9a0, .nr_mfns = 0x8},
	{ .first_mfn = 0xfe9af, .nr_mfns = 0x1},
	{ .first_mfn = 0xfea20, .nr_mfns = 0x5},
	{ .first_mfn = 0xfea27, .nr_mfns = 0x1},
	{ .first_mfn = 0xfea28, .nr_mfns = 0x5},
	{ .first_mfn = 0xfea2f, .nr_mfns = 0x1},
	{ .first_mfn = 0xfea30, .nr_mfns = 0x5},
	{ .first_mfn = 0xfea37, .nr_mfns = 0x1},
	{ .first_mfn = 0xfead0, .nr_mfns = 0x10},
	{ .first_mfn = 0xfeb00, .nr_mfns = 0x70},
	{ .first_mfn = 0xfeb90, .nr_mfns = 0x1},
	{ .first_mfn = 0xe6198, .nr_mfns = 0x1},
	{ .first_mfn = 0xe61a0, .nr_mfns = 0x1},
	{ .first_mfn = 0xe61a8, .nr_mfns = 0x1},
	{ .first_mfn = 0xe60b0, .nr_mfns = 0x1},
	{ .first_mfn = 0xe60a0, .nr_mfns = 0x1},
	{ .first_mfn = 0xffc10, .nr_mfns = 0x10},
	{ .first_mfn = 0xe6550, .nr_mfns = 0x1},
};


static uint32_t domd_irqs[] = {
//gpio@e6050000
    36,
//gpio@e6051000
    37,
//gpio@e6052000
    38,
//gpio@e6053000
    39,
//gpio@e6054000
    40,
//gpio@e6055000
    41,
//gpio@e6055400
    42,
//gpio@e6055800
    43,
//mfis-as
    212,
//interrupt-controller@e61c0000
    32, 33, 34, 35, 193, 50,
//i2c@e6510000
    318,
//i2c@e66d8000
    51,
//crypto@e6601000
    103,
//ethernet@e6800000
    71, 72, 73, 74, 75, 76, 77, 78, 79, 80, 81, 82, 83, 84, 85, 86, 87, 88, 89, 90, 91, 92, 93, 94, 95,
//serial@e6e68000
    185,
//csi2@fea80000
    216,
//csi2@feaa0000
    278,
//rpc0@ee200000
    70,
//video@e6ef0000
    220,
//video@e6ef1000
    221,
//video@e6ef2000
    222,
//video@e6ef3000
    223,
//video@e6ef4000
    206,
//video@e6ef5000
    207,
//video@e6ef6000
    208,
//video@e6ef7000
    203,
//dma-controller@e6700000
    231, 232, 233, 234, 235, 236, 237, 238, 239, 240, 241, 242, 243, 244, 245, 246, 247,
//dma-controller@e7300000
    251, 345, 252, 346, 248, 340, 341, 342, 343, 344, 249, 250, 347, 348, 349, 350, 351,
//dma-controller@e7310000
    448, 449, 450, 451, 452, 453, 454, 455, 456, 457, 458, 459, 460, 461, 462, 463, 429,
//dma-controller@ec700000
    352, 353, 354, 355, 356, 357, 358, 359, 360, 361, 362, 363, 364, 365, 366, 367, 382,
//dma-controller@ec720000
    383, 368, 369, 370, 371, 372, 373, 374, 375, 376, 377, 378, 379, 380, 381, 414, 415,
//dma-controller@e65a0000
    141,
//dma-controller@e65b0000
    142,
//usb@e6590000
    139,
//usb@ee000000
    134,
//usb@ee020000
    136,
//usb@ee080000
    140,
//usb@ee0a0000
    144,
//mmc@ee100000
    197,
//mmc@ee140000
    199,
//mmc@ee160000
    200,
//src-0
    384,
//src-1
    385,
//src-2
    386,
//src-3
    387,
//src-4
    388,
//src-5
    389,
//src-6
    390,
//src-7
    391,
//src-8
    392,
//src-9
    393,
//ssi-0
    402,
//ssi-1
    403,
//ssi-2
    404,
//ssi-3
    405,
//ssi-4
    406,
//ssi-5
    407,
//ssi-6
    408,
//ssi-7
    409,
//ssi-8
    410,
//ssi-9
    411,
//adsp@ec800000
//  269,
//pcie@fe000000
    148, 149, 150,
//pcie@ee800000
    180, 181, 182,
//gsx@fd000000
    151,
//vcp4@fe910000
    292, 293,
//vcp4@fe900000
    272, 273,
//vcp4@fe8d0000
    412, 413, 255,
//fdpm@fe940000
    294,
//vspm@fe960000
    298,
//vspm@fe9a0000
    476,
//vsp@fea20000
    498,
//vsp@fea28000
    499,
//vsp@fea30000
    500,
//hdmi@fead0000
    421,
//display@feb00000
    288, 300, 301,
//thermal@e6198000
    99, 100, 101,
//i2c@e60b0000
    205,
//dma-controller@ffc10000
    480, 481, 482, 483, 484, 485, 486, 487, 488,
    489, 490, 491, 492, 493, 494, 495, 496,
//serial@e6550000
    187,
};

extern char __img_ipl_start[];
extern char __img_ipl_end[];
extern char __dtb_ipl_start[];
extern char __dtb_ipl_end[];

static int load_ipl_image(uint8_t *buf, size_t bufsize,
			  uint64_t image_load_offset, void *image_info)
{
	ARG_UNUSED(image_info);
	memcpy(buf, __img_ipl_start + image_load_offset, bufsize);
	return 0;
}

static ssize_t get_ipl_image_size(void *image_info, uint64_t *size)
{
	ARG_UNUSED(image_info);
	*size = __img_ipl_end - __img_ipl_start;
	return 0;
}

struct xen_domain_cfg domd_cfg = {
	.mem_kb = 0x200000, /* 2Gb */

	.flags = (XEN_DOMCTL_CDF_hvm | XEN_DOMCTL_CDF_hap | XEN_DOMCTL_CDF_iommu),
	.max_evtchns = 10,
	.max_vcpus = 4,
	.gnt_frames = 32,
	.max_maptrack_frames = 1,

	.iomems = domd_iomems,
	.nr_iomems = ARRAY_SIZE(domd_iomems),

	.irqs = domd_irqs,
	.nr_irqs = ARRAY_SIZE(domd_irqs),

	.gic_version = XEN_DOMCTL_CONFIG_GIC_V2,
	.tee_type = XEN_DOMCTL_CONFIG_TEE_NONE,

	.dtdevs = domd_dtdevs,
	.nr_dtdevs = ARRAY_SIZE(domd_dtdevs),

	.dt_passthrough = dt_passthrough_nodes,
	.nr_dt_passthrough = ARRAY_SIZE(dt_passthrough_nodes),
	.load_image_bytes = load_ipl_image,
	.get_image_size = get_ipl_image_size,
	.image_info = NULL,

	.dtb_start = __dtb_ipl_start,
	.dtb_end = __dtb_ipl_end,
};
```
